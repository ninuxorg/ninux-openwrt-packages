## netkit/Config.in
```kconfig
config NETKIT
	prompt "Netkit Prompt"
	tristate
	default m if CONFIG_DEVEL
	help
		Per la documentazione visita http://wiki.ninux.org
```

## ninux-ipkg-dynamicdns/Config.in
```kconfig
config NINUX_DYNAMICDNS
	prompt "Questo pacchetto prepara il router per funzionare con il servizio di DNS dinamico di ninux.org"
	tristate
	default m if CONFIG_DEVEL
	help
		Per la documentazione visita http://wiki.ninux.org/DnsDinamico
```

## ninux-ipkg-x86/Config.in
```kconfig
config NINUX_X86
	prompt "Questo pacchetto prepara il router per la rete Ninux.org"
	tristate
	default m if CONFIG_DEVEL
	help
		Per la documentazione visita http://wiki.ninux.org
```

## zzz-ninux-ipkg-ar71xx/Config.in
```kconfig
config NINUX_AR71XX
	prompt "Questo pacchetto prepara il router per la rete Ninux.org"
	tristate
	default m if CONFIG_DEVEL
	help
		Per la documentazione visita http://wiki.ninux.org
```
